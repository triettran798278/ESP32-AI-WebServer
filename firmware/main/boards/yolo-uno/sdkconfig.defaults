## firmware/main/boards/yolo-uno/sdkconfig.defaults
```kconfig
CONFIG_BOARD_TYPE_YOLO_UNO=y
CONFIG_LANGUAGE_EN_US=y
CONFIG_SR_WN_WN9_HIESP=y
# CONFIG_SR_WN_WN9_NIHAOXIAOZHI_TTS is not set
CONFIG_ESPTOOLPY_FLASHSIZE_16MB=y
CONFIG_SPIRAM=y
CONFIG_SPIRAM_MODE_OCT=y
```
